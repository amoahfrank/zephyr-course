## CMakeLists.txt
```
cmake_minimum_required(VERSION 3.20.0)

# Let Zephyr find <zephyr-course>/dts/bindings/our,driver.yaml
list(APPEND DTS_ROOT ${CMAKE_CURRENT_SOURCE_DIR}/..)

find_package(Zephyr REQUIRED HINTS $ENV{ZEPHYR_BASE})
project(app1)

target_sources(app PRIVATE src/main.cpp)

add_subdirectory(drivers/our_driver)
```

## Kconfig
```
menuconfig LED_SUBSYSTEM
	bool "LED Subsystem"
	default y
	help
	  Enable the LED blink application. Turning this off hides and
	  disables every LED option below it.

if LED_SUBSYSTEM

choice
	prompt "LED blink sleep time"
	default BLINK_SLEEP_1000MS
	help
	  Interval between LED toggles.

config BLINK_SLEEP_250MS
	bool "250ms (fast)"

config BLINK_SLEEP_500MS
	bool "500ms (quick)"

config BLINK_SLEEP_1000MS
	bool "1s (medium)"

config BLINK_SLEEP_2000MS
	bool "2s (slow)"

endchoice

config BLINK_SLEEP_TIME_MS
	int
	default 250  if BLINK_SLEEP_250MS
	default 500  if BLINK_SLEEP_500MS
	default 1000 if BLINK_SLEEP_1000MS
	default 2000 if BLINK_SLEEP_2000MS
	default 1000

menuconfig LED_ADVANCED
	bool "Advanced LED settings"

if LED_ADVANCED

config LED_BRIGHTNESS
	int "LED brightness (0-100)"
	range 0 100
	default 100

config LED_FADE_DURATION_MS
	int "LED fade duration (ms)"
	range 0 5000
	default 500

menu "Expert settings"
	visible if LED_ADVANCED

config LED_DEBUG
	bool "Enable LED debugging"

config LED_CUSTOM_PATTERN
	bool "Custom blink pattern"

endmenu

endif # LED_ADVANCED

endif # LED_SUBSYSTEM

menu "Custom drivers"

rsource "drivers/our_driver/Kconfig"

endmenu

source "Kconfig.zephyr"
```

## prj.conf
```kconfig
CONFIG_GPIO=y
CONFIG_SENSOR=y
CONFIG_LOG=y
CONFIG_SHELL=y
CONFIG_SENSOR_SHELL=n
CONFIG_VOLTAGE_DIVIDER=n
```

## app.overlay
```dts
#include <zephyr/dt-bindings/gpio/gpio.h>

/ {
	our_driver0: our_driver0 {
		compatible = "our,driver";
		gpios = <&gpio1 3 GPIO_ACTIVE_HIGH>; /* GPIO35: white LED */
		status = "okay";
	};
};

/* GPIO35 is also wired to the PWM (LEDC) controller on this board.
 * Disable it so the GPIO driver owns the pin.
 */
&pwm_led_white {
	status = "disabled";
};

&ledc0 {
	status = "disabled";
};
```

## src/main.cpp
```c
#include <zephyr/device.h>
#include <zephyr/kernel.h>
#include <zephyr/logging/log.h>

LOG_MODULE_REGISTER(main, LOG_LEVEL_INF);

int main(void)
{
	const struct device *driver = DEVICE_DT_GET(DT_NODELABEL(our_driver0));

	if (!device_is_ready(driver)) {
		LOG_ERR("%s is not ready", driver->name);
		return 0;
	}

	LOG_INF("%s is ready", driver->name);
	LOG_INF("Shell: sensor info %s | sensor fetch %s | sensor read %s",
		driver->name, driver->name, driver->name);
	LOG_INF("Shell: sensor set %s <0|1> (1 = keep LED on after read)", driver->name);

	/* ....the shell runs in its own thread. */
	return 0;
}
```

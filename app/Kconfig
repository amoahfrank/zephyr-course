## app/Kconfig
```kconfig
menuconfig LED_SUBSYSTEM
    bool "LED Subsystem"
    default y
    help
        enable the LED blink app... turning this config off...
        ...hides and disable every LED option below it.

if LED_SUBSYSTEM


choice
    prompt "LED blink sleep time (1s (medium))"
    default BLINK_SLEEP_1000MS
    help
        time interval between led toggles.

config BLINK_SLEEP_250MS
    bool "Fast"

config BLINK_SLEEP_500MS
    bool "Quick"

config BLINK_SLEEP_1000MS
    bool "Normal"

config BLINK_SLEEP_2000MS
    bool "Slow"

endchoice

config BLINK_SLEEP_TIME_MS
    int 
	default 250 if BLINK_SLEEP_250MS
	default 500 if BLINK_SLEEP_500MS
	default 1000 if BLINK_SLEEP_1000MS
	default 2000 if BLINK_SLEEP_2000MS
    default 1000
    help
        Say yes to enable the LED prompt sleep time configuration.
        ...You should see the LED prompt blinking at the configured interval...
        ...This doesn't show in the menuconfig because there is no prompt (only the type int is declared)

menuconfig LED_ADVANCED
    bool "Advanced LED settings"
    help
        extra tuning for brightness and fade behaviour.

if LED_ADVANCED

config LED_BRIGHTNESS
    int "LED Brightness (0-100 )"
    range 0 100
    default 100
    help
        setting the brightness level for the LED.

config LED_FADE_DURATION_MS
    int "LED Fade Duration (ms)"
    range 0 5000
    default 500
    help
        setting the fade duration for the LED.

menu "Expert settings"
    visible if LED_ADVANCED

config LED_DEBUG
    bool "Enable LED debugging"

config LED_CUSTOM_PATTERN
    bool "Custom blink pattern"

endmenu

endif

endif

source "Kconfig.zephyr"
    
```

## app1/drivers/our_driver/Kconfig
```kconfig
menuconfig OUR_DRIVER
	bool "Our custom LED sensor driver"
	default y
	depends on DT_HAS_OUR_DRIVER_ENABLED # only if the node is in the devicetree
	depends on SENSOR
	select GPIO
	help
	  Simple sensor driver for the on-board LED.
	  sample_fetch turns the LED on, channel_get turns it off.
```

## blinky/Kconfig
```kconfig
config APP_HEARTBEAT_PERIOD_MS
    int "Heartbeat LED period (ms)"
    default 500
    range 100 500
    help
        Time between heartbeat LED toggles, in milliseconds.

source "Kconfig.zephyr"
    
```

## dts/bindings/our,driver.yaml
```yaml
description: Simple on-board LED exposed through the Zephyr sensor API (L6 exercise)

compatible: "our,driver"

include: base.yaml

properties:
  gpios:
    type: phandle-array
    required: true
    description: GPIO that drives the LED
```

## hello_world/boards/heltec_custom_v3/Kconfig.defconfig
```kconfig
# SPDX-FileCopyrightText: Copyright The Zephyr Project Contributors
# SPDX-License-Identifier: Apache-2.0

if BOARD_HELTEC_CUSTOM_V3_ESP32S3_PROCPU

config POWER_DOMAIN
	default y

config POWER_DOMAIN_GPIO
	default y

endif # BOARD_HELTEC_CUSTOM_V3_ESP32S3_PROCPU
```

## hello_world/boards/heltec_custom_v3/board.yml
```yaml
board:
  name: heltec_custom_v3
  full_name: heltec Custom V3
  vendor: heltec
  socs:
  - name: esp32s3
```

## hello_world/boards/heltec_scratch_v3/Kconfig
```kconfig
# SPDX-License-Identifier: Apache-2.0

config HEAP_MEM_POOL_ADD_SIZE_BOARD
	int
	default 4096 if BOARD_HELTEC_SCRATCH_V3_ESP32S3_PROCPU
```

## hello_world/boards/heltec_scratch_v3/Kconfig.heltec_scratch_v3
```kconfig
# SPX-License-Identifier: Apache-2.0

config BOARD_HELTEC_SCRATCH_V3
    select SOC_ESP32S3_FN8
    select SOC_ESP32S3_PROCPU if BOARD_HELTEC_SCRATCH_V3_ESP32S3_PROCPU
```

## hello_world/boards/heltec_scratch_v3/board.yml
```yaml
board:
  name: heltec_scratch_v3
  full_name: heltec Scratch V3 (from scratch)
  vendor: heltec
  socs:
  - name: esp32s3
```
